;
; ee19b032_partC_midsem_ee2016.asm
;
; Created: 11/7/2020 4:28:07 PM
; Author : KATARI HARI CHANDAN
;										5 TAP FIR FILTER
;


; Replace with your application code

.CSEG
LDI ZL, LOW(FIR_COEFF<<1);
LDI ZL, HIGH(FIR_COEFF<<1);
LDI XL, 0X60;
LDI XH, 0X00;
LDI R31, 5;
STORING_COEFFS: LPM R20, Z+;
ST X+, R20;
DEC R31;
BRNE STORING_COEFFS;

LDI ZL, LOW(SAMPLING_VALUES<<1);
LDI ZH, HIGH(SAMPLING_VALUES<<1);
LDI YL, 0X80;
LDI YH, 0X00;
LDI R31, 4;
STORING_SAMPLING_VALUES: LPM R20, Z+;
ST Y+, R20;
DEC R31;
BRNE STORING_SAMPLING_VALUES;

LDI R28, LOW(500); this is the counter for 800 samples
LDI R29, HIGH(500);
LDI R26, 0XB0; storing address of output location
LDI R27, 0X00;

LATEST_SAMPLE:LPM R2, Z+;		Already 4 samples are stored and now we are storing the 5th sample.(Latest sample)
ST Y, R2;				We did not increment Y this time.

LDI XL, 0X60;
LDI XH, 0X00;
LDI R31, 5;		This is muptiply and add counter. We are setting it to 5 so that, it multiplies and accumulates 5 times.
LDI R25, 0;
MOV R2,R25;	R4-R3-R2(24 bit storage) Store the accumulated result. (R4 is MS Byte and R2 is LS Byte) Hence we are initializing those bytes to 0s.
MOV R3,R25;	We took 3 bytes because the sum might contain a carry by which 8bit+8bit = 16 bit + carry. Hence we took 24 bit storage for the accumulated result.
MOV R4,R25;

MUL_ACC:LD R16, X+; multiply and accumulate
LD R17, Y;
MULS R16,R17;	MULS operation stores the result in R0,R1 registers.(Upper Byte R1 and Lower Byte R2)
LDI R25, 0;
TST R1;			Let us Test whether the result of the multiplication is positive or negative by testing the upper byte of the result.
BRPL IF_POSITIVE;	If the TST result is positive, it branches to "IF_POSITIVE" line of the code.
LDI R25, 0XFF;					If the product result in negative, since we are suppose to report the 2's compliment, we are making all the bits in front of the number as 11111...
IF_POSITIVE:ADD R2, R0;		
ADC R3, R1;
ADC R4, R20;
DEC YL;
CPI YL, 0X7F;
BRNE TO_NEXT_OLDER_SAMPLE ;
LDI YL, 0X84; go to bottom of buffer if went over the top
LDI YH, 0X00;
TO_NEXT_OLDER_SAMPLE:DEC R16; decrement MAC counter
BRNE MUL_ACC;
INC YL;
CPI YL, 0X85
BRNE TO_NEXT_BUFFER;

LDI YL, 0X80; 
TO_NEXT_BUFFER:MOV R5, R26;		Go to top of next buffer if went below the bottom of the older buffer.
MOV R6, R27;
MOV R26, YL;
MOV R27, YH;
MOV YL, R5;
MOV YH, R6;
ST Y+, R3; store output in the SRAM
MOV R5, R26;
MOV R6, R27;
MOV R26, YL;
MOV R27, YH;
MOV YL, R5;
MOV YH, R6;
SBIW R29:R28, 1; decrement the 500 sample counter
BRNE LATEST_SAMPLE;
NOP;
FIR_COEFF: .db 0XCF, 0X0D
		.db 0X58, 0X0D
		.db 0XCF, 0X00

SAMPLING_VALUES: .db 0x0, 0x87
.db 0xb5, 0x4b
.db 0x79, 0x0
.db 0x87, 0xb5
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.db 0x4b, 0x79
		




